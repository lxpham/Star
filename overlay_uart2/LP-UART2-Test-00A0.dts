/*
* Copyright (C) 2013 CircuitCo
*
* Virtual cape for UART2 on connector pins P9.21 P9.22
*
* This program is free software; you can redistribute it and/or modify
* it under the terms of the GNU General Public License version 2 as
* published by the Free Software Foundation.
*/
/dts-v1/;
/plugin/;
/{
	compatible = "ti,beaglebone", "ti,beaglebone-black";
	/* identification */
	part-number = "BB-UART2";
	version = "00A0";
	/* state the resources this cape uses */
	exclusive-use =
	/* the pin header uses */
	"P9.21", /* uart2_txd */
	"P9.22", /* uart2_rxd */
	/* the hardware ip uses */
	"uart2";
	fragment@0 {
		target = <&am33xx_pinmux>;
		__overlay__ {
			bb_uart2_pins: pinmux_bb_uart2_pins {
				pinctrl-single,pins = <
					0x150 0x21 /* P9.21 uart1_txd.uart2_txd MODE1 OUTPUT (TX) */
					0x154 0x01 /* P9.22 uart1_rxd.uart2_rxd MODE1 INPUT (RX) */
				>;
			};
		};
	};
fragment@1 {
		target = <&uart3>; /* really uart1 */
		__overlay__ {
			status = "okay";
			pinctrl-names = "default";
			pinctrl-0 = <&bb_uart2_pins>;
		};
	};
};
